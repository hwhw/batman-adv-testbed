## buildroot-external/Config.in
```kconfig
source "$BR2_EXTERNAL/package/batman-adv-legacy/Config.in"
source "$BR2_EXTERNAL/package/batctl-legacy/Config.in"
source "$BR2_EXTERNAL/package/alfred/Config.in"
source "$BR2_EXTERNAL/package/fastd/Config.in"
source "$BR2_EXTERNAL/package/libuecc/Config.in"
source "$BR2_EXTERNAL/package/libsodium/Config.in"
```

## buildroot-external/package/alfred/Config.in
```kconfig
config BR2_PACKAGE_ALFRED
	bool "alfred"
	select BR2_PACKAGE_LIBCAP
	help
	  Alfred is the Almighty Lightweight Fact Remote Exchange Daemon

	  http://www.open-mesh.org/projects/alfred
```

## buildroot-external/package/batman-adv-legacy/Config.in
```kconfig
config BR2_PACKAGE_BATMAN_ADV_LEGACY
	bool "batman-adv-legacy"
	depends on BR2_LINUX_KERNEL
	help
      batman-adv compat 14, with a few extra patches on top of 2013.4

	  https://github.com/freifunk-gluon/batman-adv-legacy

if BR2_PACKAGE_BATMAN_ADV_LEGACY

config BR2_PACKAGE_BATMAN_ADV_LEGACY_DEBUG
        bool "build batman-adv-legacy with debug output/information"

config BR2_PACKAGE_BATMAN_ADV_LEGACY_BLA
        bool "build batman-adv-legacy with bridge loop avoidance"

config BR2_PACKAGE_BATMAN_ADV_LEGACY_DAT
        bool "build batman-adv-legacy with distributed ARP table"

config BR2_PACKAGE_BATMAN_ADV_LEGACY_NC
        bool "build batman-adv-legacy with network coding"
endif

comment "batman-adv-legacy needs a kernel"
	depends on !BR2_LINUX_KERNEL
```

## buildroot-external/package/fastd/Config.in
```kconfig
config BR2_PACKAGE_FASTD
	bool "fastd"
    select BR2_PACKAGE_JSON_C
    select BR2_PACKAGE_LIBUECC
    select BR2_PACKAGE_LIBSODIUM
	help
	  Fast and Secure Tunnelling Daemon

	  http://git.universe-factory.net/fastd

if BR2_PACKAGE_FASTD

config BR2_PACKAGE_FASTD_WITH_OPENSSL
        bool "build fastd with openssl"
        select BR2_PACKAGE_OPENSSL
        help
          link with the OpenSSL which can speed up AES crypto by
          some orders of magnitude

endif
```

## buildroot-external/package/libsodium/Config.in
```kconfig
config BR2_PACKAGE_LIBSODIUM
	bool "libsodium"
	help
	  A high-security, cross-platform, easy-to-use crypto library

	  https://download.libsodium.org/doc/
```
